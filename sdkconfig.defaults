## sdkconfig.defaults
```kconfig
# sdkconfig.defaults
#
# Perfil de build para ESP32-S3 N16R8 (16 MB flash, 8 MB PSRAM octal).
# Usar:
#   idf.py set-target esp32s3
#   idf.py build

# Target
CONFIG_IDF_TARGET="esp32s3"

# Partition table custom con OTA
CONFIG_PARTITION_TABLE_CUSTOM=y
CONFIG_PARTITION_TABLE_CUSTOM_FILENAME="partitions.csv"

# Flash 16 MB
CONFIG_ESPTOOLPY_FLASHSIZE_16MB=y
CONFIG_ESPTOOLPY_FLASHSIZE="16MB"

# PSRAM octal 8 MB (R8)
CONFIG_SPIRAM=y
CONFIG_SPIRAM_MODE_OCT=y
CONFIG_SPIRAM_TYPE_AUTO=y
CONFIG_SPIRAM_SPEED_80M=y
CONFIG_SPIRAM_ALLOW_STACK_EXTERNAL_MEMORY=y
CONFIG_SPIRAM_MALLOC_ALWAYSINTERNAL=4096
CONFIG_SPIRAM_MALLOC_RESERVE_INTERNAL=32768

# WiFi (idéntico a C3)
CONFIG_ESP_WIFI_SOFTAP_SUPPORT=y
CONFIG_ESP_WIFI_ENTERPRISE_SUPPORT=y

# AMPDU BA window 32 (era 6): mayor agregación 802.11n. Con 1-2 STA podemos
# permitirnos ventanas grandes sin penalizar fairness multi-cliente.
# IDF exige RX_BA_WIN <= 2 * STATIC_RX_BUFFER_NUM, por eso subimos a 16.
CONFIG_ESP_WIFI_STATIC_RX_BUFFER_NUM=16
CONFIG_ESP_WIFI_TX_BA_WIN=32
CONFIG_ESP_WIFI_RX_BA_WIN=32

# lwIP - NAPT & IP Forward (no romper repetidor)
CONFIG_LWIP_IP_FORWARD=y
CONFIG_LWIP_IPV4_NAPT=y
CONFIG_LWIP_MAX_SOCKETS=24
# TCP windows ↑ a 64 KB (era 5744): elimina cuello de banda BDP en TCP
# single-stream sobre Tailscale. Coste RAM: ~120 KB extra por socket activo
# (aceptable con 8 MB PSRAM y SPIRAM_ALLOW_STACK_EXTERNAL_MEMORY=y).
CONFIG_LWIP_TCP_SND_BUF_DEFAULT=65535
CONFIG_LWIP_TCP_WND_DEFAULT=65535
CONFIG_LWIP_TCP_RECVMBOX_SIZE=16
CONFIG_LWIP_UDP_RECVMBOX_SIZE=16
CONFIG_LWIP_TCPIP_RECVMBOX_SIZE=32
CONFIG_LWIP_IP4_FRAG=y
CONFIG_LWIP_IP4_REASSEMBLY=y

# DHCP
CONFIG_LWIP_DHCPS=y
CONFIG_LWIP_DHCP_RESTORE_LAST_IP=y

# HTTP server (igual que C3)
CONFIG_HTTPD_MAX_REQ_HDR_LEN=1024
CONFIG_HTTPD_MAX_URI_LEN=512

# TLS / mbedTLS (preparación para Tailscale en fases siguientes)
CONFIG_ESP_TLS_USING_MBEDTLS=y
CONFIG_MBEDTLS_SSL_PROTO_TLS1_2=y
CONFIG_MBEDTLS_CERTIFICATE_BUNDLE=y
CONFIG_MBEDTLS_CERTIFICATE_BUNDLE_DEFAULT_CMN=y

# ChaCha20-Poly1305 (needed by MicroLink Noise handshake AEAD via PSA Crypto)
# Note: CONFIG_MBEDTLS_CHACHAPOLY_C controls PSA_WANT_ALG_CHACHA20_POLY1305
# which is what ml_noise.c uses via psa_aead_encrypt(PSA_ALG_CHACHA20_POLY1305).
# MBEDTLS_POLY1305_C is auto-enabled from CHACHAPOLY_C in IDF 6.1.
CONFIG_MBEDTLS_CHACHA20_C=y
CONFIG_MBEDTLS_CHACHAPOLY_C=y

# Task stack del main
CONFIG_ESP_MAIN_TASK_STACK_SIZE=8192

# --- Performance tuning para Tailscale (Tier 1) -----------------------------
# CPU @ 240 MHz: el cómputo ChaCha20-Poly1305 / Noise / WG escala lineal.
CONFIG_ESP_DEFAULT_CPU_FREQ_MHZ_240=y
CONFIG_ESP_DEFAULT_CPU_FREQ_MHZ=240

# Compilador a -O2 (PERF) en app y en mbedTLS. ChaCha20-Poly1305 PSA cae
# 30-40% en -Os; Noise + WG hot path otros 25% en -Og.
CONFIG_COMPILER_OPTIMIZATION_PERF=y
CONFIG_COMPILER_OPTIMIZATION_DEBUG=n
CONFIG_COMPILER_OPTIMIZATION_SIZE=n
CONFIG_MBEDTLS_COMPILER_OPTIMIZATION_PERF=y
CONFIG_MBEDTLS_COMPILER_OPTIMIZATION_SIZE=n
CONFIG_MBEDTLS_COMPILER_OPTIMIZATION_NONE=n

# Asserts: mantener detección de fallos críticos pero sin penalización.
# SILENT = aborta sin imprimir mensaje (mantiene el chequeo barato).
CONFIG_COMPILER_OPTIMIZATION_ASSERTIONS_ENABLE=n
CONFIG_COMPILER_OPTIMIZATION_ASSERTIONS_SILENT=y

# I-cache 32 KB (8 ways, line 32 B): el hot path Noise+WG no entra en 16 KB.
CONFIG_ESP32S3_INSTRUCTION_CACHE_32KB=y
CONFIG_ESP32S3_INSTRUCTION_CACHE_16KB=n
CONFIG_ESP32S3_INSTRUCTION_CACHE_SIZE=0x8000

# Logs / watchdog (igual que C3)
# Default boot level INFO; runtime puede subir hasta VERBOSE via Web UI.
CONFIG_LOG_DEFAULT_LEVEL_INFO=y
CONFIG_LOG_MAXIMUM_EQUALS_DEFAULT=n
CONFIG_LOG_MAXIMUM_LEVEL_VERBOSE=y
CONFIG_ESP_TASK_WDT_TIMEOUT_S=30

# --- MicroLink (Fase 2: presente en build, NO instanciado en runtime) -------
# Filosofía AGENTS.md §5: HTTPD interno desactivado.
# Filosofía AGENTS.md §3: Tailscale desactivado por defecto.
# Sin cellular ni network-switch (no aplica al repetidor WiFi).
# Sin zero-copy WG (evita raw lwIP PCB en IDF 6.1).
CONFIG_ML_ENABLE_CONFIG_HTTPD=n
CONFIG_ML_ENABLE_CELLULAR=n
CONFIG_ML_ENABLE_NET_SWITCH=n
CONFIG_ML_ZERO_COPY_WG=n
CONFIG_ML_MAX_PEERS=8
CONFIG_ML_NVS_MAX_PEERS=32
CONFIG_ML_H2_BUFFER_SIZE_KB=256
CONFIG_ML_JSON_BUFFER_SIZE_KB=256
# Credentials vacías a propósito: la auth_key se persiste en NVS desde la
# Web UI del repetidor (Fase 3+), nunca desde sdkconfig.
CONFIG_ML_WIFI_SSID=""
CONFIG_ML_WIFI_PASSWORD=""
CONFIG_ML_TAILSCALE_AUTH_KEY=""
CONFIG_ML_DEVICE_NAME=""
```
